## drivers/timer/Kconfig.hc32
```kconfig
# SPDX-License-Identifier: Apache-2.0

config HC32_LPTIM_TIMER
	bool "HC32 LPTIM system timer driver"
	default y
	depends on DT_HAS_HDSC_HC32_LPTIM_ENABLED
	select TICKLESS_CAPABLE
	select SYSTEM_TIMER_HAS_DISABLE_SUPPORT
	help
	  This module implements a kernel device driver for using the LPTIM
	  peripheral as the system clock. It provides the standard "system clock
	  driver" interfaces.
```

## dts/bindings/clock/silabs,series0-hfxo.yaml
```yaml
compatible: "silabs,series0-hfxo"

title: Silicon Labs Series 0 HFXO (High-Frequency Crystal Oscillator)

description: |
  High-Frequency Crystal Oscillator peripheral.

include: fixed-clock.yaml

properties:
  ctune:
    type: int
    description: |
      Load capacitance configuration.
  precision:
    type: int
    description: Precision configuration
```

## dts/bindings/clock/silabs,series0-lfrco.yaml
```yaml
compatible: "silabs,series0-lfrco"

title: Silicon Labs Series 0 LFRCO (Low-Frequency RC Oscillator)

description: |
  Low-Frequency RC Oscillator peripheral.

include: fixed-clock.yaml

properties:
  precision:
    type: int
    description: Precision configuration
```

## dts/bindings/clock/silabs,series0-lfxo.yaml
```yaml
compatible: "silabs,series0-lfxo"

title: Silicon Labs Series 0 LFXO (Low-Frequency Crystal Oscillator)

description: |
  Low-Frequency Crystal Oscillator peripheral.

include: fixed-clock.yaml

properties:
  ctune:
    type: int
    description: |
      Load capacitance configuration.
  precision:
    type: int
    description: Precision configuration
```

## dts/bindings/timer/hdsc,hc32-lptim.yaml
```yaml
# SPDX-License-Identifier: Apache-2.0

description: HDSC HC32 Low Power Timer

compatible: "hdsc,hc32-lptim"

include: base.yaml

properties:
  reg:
    required: true

  interrupts:
    required: true

  clocks:
    required: true
```
