## boards/arm/gardena_rm_sim3u/gardena_rm_sim3u_defconfig
```kconfig
CONFIG_SOC_SERIES_SIM3U=y

# enable uart driver
CONFIG_SERIAL=y

# enable console
CONFIG_CONSOLE=y
CONFIG_UART_CONSOLE=y

# enable GPIO
CONFIG_GPIO=y

CONFIG_TEST_RANDOM_GENERATOR=y
CONFIG_TIMER_RANDOM_GENERATOR=y

CONFIG_SPI=y
CONFIG_FLASH=y
```

## drivers/adc/Kconfig.hc32
```kconfig
# SPDX-License-Identifier: Apache-2.0

config ADC_HC32
	bool "HC32 ADC driver"
	default y
	depends on DT_HAS_HDSC_HC32_ADC_ENABLED
	select ADC_CONFIGURABLE_BUFFER_AMPLIFIER
	help
	  Enable HDSC HC32 ADC driver
```

## drivers/clock_control/Kconfig.hdsc
```kconfig
# HDSC Clock Controller Driver configuration options

# SPDX-License-Identifier: Apache-2.0

config CLOCK_CONTROL_HDSC_HC32
	bool "HDSC HC32 Clock Controller Driver"
	default y
	depends on DT_HAS_HDSC_HC32_SYSCTRL_ENABLED
```

## drivers/gpio/Kconfig.hc32
```kconfig
# SPDX-License-Identifier: Apache-2.0

config GPIO_HC32
	bool "HC32 GPIO driver"
	default y
	depends on DT_HAS_HDSC_HC32_GPIO_ENABLED
	help
	  Enable the HC32 GPIO driver.
```

## drivers/pinctrl/Kconfig.hc32
```kconfig
# SPDX-License-Identifier: Apache-2.0

config PINCTRL_HC32
	bool "HC32 pin controller driver"
	default y
	depends on DT_HAS_HDSC_HC32_PINCTRL_ENABLED
	help
	  HC32 pin controller driver.
```

## drivers/serial/Kconfig.hc32
```kconfig
# SPDX-License-Identifier: Apache-2.0

config UART_HC32_LPUART
	bool "HC32 LPUART serial driver"
	default y
	depends on DT_HAS_HDSC_HC32_LPUART_ENABLED
	depends on CLOCK_CONTROL
	select PINCTRL
	select SERIAL_HAS_DRIVER
	select SERIAL_SUPPORT_INTERRUPT
```

## dts/bindings/adc/hdsc,hc32-adc.yaml
```yaml
# SPDX-License-Identifier: Apache-2.0

description: HDSC HC32 ADC

compatible: "hdsc,hc32-adc"

include: [adc-controller.yaml, pinctrl-device.yaml]

properties:
  reg:
    required: true

  clocks:
    required: true

  channels:
    type: int
    description: Number of external channels
    required: true

  interrupts:
    required: true

  "#io-channel-cells":
    const: 1

  clock-div:
    type: int
    description: PCLK clock divider
    enum:
      - 1
      - 2
      - 4
      - 8

  temp-sensor-enabled:
    type: boolean
    description: Enable internal temperature sensor.

io-channel-cells:
  - input
```

## dts/bindings/clock/hdsc,hc32-derived.yaml
```yaml
# SPDX-License-Identifier: Apache-2.0

description: |
  The representation of HC32's derived clocks

compatible: "hdsc,hc32-derived"

include:
  - name: fixed-factor-clock.yaml
    property-blocklist:
      - clock-mult
```

## dts/bindings/clock/hdsc,hc32-rcl.yaml
```yaml
# SPDX-License-Identifier: Apache-2.0

description: |
  The representation of HC32's RCL clock

compatible: "hdsc,hc32-rcl"

include: fixed-clock.yaml

properties:
  startup-time-cycles:
    type: int
    enum:
      - 4
      - 16
      - 64
      - 256
    description: Clock startup time in cycles
    required: true
```

## dts/bindings/clock/hdsc,hc32-sysctrl.yaml
```yaml
# Copyright (c) 2022 Andrei-Edward Popa
# SPDX-License-Identifier: Apache-2.0

description: Raspberry Pi Pico clock controller node

compatible: "hdsc,hc32-sysctrl"

include: [base.yaml, clock-controller.yaml]

properties:
  reg:
    required: true

  "#clock-cells":
    const: 1

clock-cells:
  - clk-id
```

## dts/bindings/clock/hdsc,hc32-xth.yaml
```yaml
# SPDX-License-Identifier: Apache-2.0

description: |
  The representation of HC32's XTH clock

compatible: "hdsc,hc32-xth"

include: fixed-clock.yaml

properties:
  drive:
    type: int
    enum:
      - 0
      - 1
      - 2
      - 3
    description: Crystal drive capability
    required: true

  startup-time-cycles:
    type: int
    enum:
      - 256
      - 1024
      - 4096
      - 16384
    description: Clock startup time in cycles
    required: true
```

## dts/bindings/clock/hdsc,hc32-xtl.yaml
```yaml
# SPDX-License-Identifier: Apache-2.0

description: |
  The representation of HC32's XTL clock

compatible: "hdsc,hc32-xtl"

include: fixed-clock.yaml

properties:
  amplitude:
    type: int
    enum:
      - 0
      - 1
      - 2
      - 3
    description: Crystal oscillation amplitude
    required: true

  drive:
    type: int
    enum:
      - 0
      - 1
      - 2
      - 3
    description: Crystal drive capability
    required: true

  startup-time-cycles:
    type: int
    enum:
      - 256
      - 1024
      - 4096
      - 16384
    description: Clock startup time in cycles
    required: true
```

## dts/bindings/flash_controller/hdsc,hc32-flash-controller.yaml
```yaml
# SPDX-License-Identifier: Apache-2.0

compatible: "hdsc,hc32-flash-controller"

description: HDSC HC32 flash controller

include: flash-controller.yaml
```

## dts/bindings/gpio/hdsc,hc32-gpio.yaml
```yaml
# SPDX-License-Identifier: Apache-2.0

description: HC32 GPIO node

compatible: "hdsc,hc32-gpio"

include: [gpio-controller.yaml, base.yaml]

properties:
  reg:
    required: true
    description: Register offset of this gpio port.

  clocks:
    required: true

  "#gpio-cells":
    const: 2

gpio-cells:
  - pin
  - flags
```

## dts/bindings/pinctrl/hdsc,hc32-pinctrl.yaml
```yaml
# SPDX-License-Identifier: Apache-2.0

description: |
    HDSC HC32 pinctrl node

compatible: "hdsc,hc32-pinctrl"

include: base.yaml

properties:
  clocks:
    required: true

child-binding:
  description: |
    Each child node defines the configuration for a particular state.
  child-binding:
    description: |
      The grandchild nodes group pins that share the same pin configuration.

    include:
      - name: pincfg-node.yaml
        property-allowlist:
          - bias-disable
          - bias-pull-down
          - bias-pull-up
          - drive-push-pull
          - drive-open-drain
          - output-disable
          - output-enable
          - output-high
          - output-low

    properties:
      pinmux:
        required: true
        type: array
        description: |
          An array of pins sharing the same group properties. The pins should
          be defined using pre-defined macros or, alternatively, using the
          HC32_PINMUX utility macro.

      drive-strength:
        type: string
        enum:
          - "high"
          - "low"
        default: "high"
        description: |
          The drive strength of a pin, relative to full-driver strength.
          The default value is "high", which is the reset value.

      analog-mode:
        type: boolean
        description: |
          Set the pin to analog mode.
```

## dts/bindings/serial/hdsc,hc32-lpuart.yaml
```yaml
# SPDX-License-Identifier: Apache-2.0

description: HC32 USART

compatible: "hdsc,hc32-lpuart"

include: [uart-controller.yaml, pinctrl-device.yaml]

properties:
  reg:
    required: true

  interrupts:
    required: true

  clocks:
    required: true
```

## soc/hdsc/Kconfig.soc
```kconfig
config SOC_FAMILY
	default "hdlc_hc32" if SOC_FAMILY_HDSC_HC32

rsource "*/Kconfig.soc"
```

## soc/hdsc/hdsc_hc32/Kconfig
```kconfig
if SOC_FAMILY_HDSC_HC32

config SOC_FAMILY_HDSC_HC32
	select HAS_SEGGER_RTT if ZEPHYR_SEGGER_MODULE
	select BUILD_OUTPUT_HEX

rsource "*/Kconfig"

endif # SOC_FAMILY_HDSC_HC32
```

## soc/hdsc/hdsc_hc32/hc32l13x/Kconfig
```kconfig
config SOC_HC32L13X
	select ARM
	select CLOCK_CONTROL
	select CPU_CORTEX_M0PLUS
	select CPU_CORTEX_M_HAS_SYSTICK
	select SOC_EARLY_INIT_HOOK
	select TIMER_READS_ITS_FREQUENCY_AT_RUNTIME
```

## soc/hdsc/hdsc_hc32/hc32l13x/Kconfig.soc
```kconfig
config SOC_HC32L13X
	bool
	select SOC_FAMILY_HDSC_HC32

config SOC
	default "hc32l13x" if SOC_HC32L13X
```
